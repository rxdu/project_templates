/*
******************************************************************************
File:     main.c
Info:     Generated by Atollic TrueSTUDIO(R) 8.1.0   2018-04-23

The MIT License (MIT)
Copyright (c) 2009-2017 Atollic AB

Permission is hereby granted, free of charge, to any person obtaining a copy
of this software and associated documentation files (the "Software"), to deal
in the Software without restriction, including without limitation the rights
to use, copy, modify, merge, publish, distribute, sublicense, and/or sell
copies of the Software, and to permit persons to whom the Software is
furnished to do so, subject to the following conditions:

The above copyright notice and this permission notice shall be included in all
copies or substantial portions of the Software.

THE SOFTWARE IS PROVIDED "AS IS", WITHOUT WARRANTY OF ANY KIND, EXPRESS OR
IMPLIED, INCLUDING BUT NOT LIMITED TO THE WARRANTIES OF MERCHANTABILITY,
FITNESS FOR A PARTICULAR PURPOSE AND NONINFRINGEMENT. IN NO EVENT SHALL THE
AUTHORS OR COPYRIGHT HOLDERS BE LIABLE FOR ANY CLAIM, DAMAGES OR OTHER
LIABILITY, WHETHER IN AN ACTION OF CONTRACT, TORT OR OTHERWISE, ARISING FROM,
OUT OF OR IN CONNECTION WITH THE SOFTWARE OR THE USE OR OTHER DEALINGS IN THE
SOFTWARE.

******************************************************************************
*/

/* Includes */
#include <stddef.h>

/* Private typedef */

/* Private define  */

/* Private macro */

/* Private variables */

/* Private function prototypes */
void Undefined_Handler(void) __attribute__((naked));
void SWI_Handler(void) __attribute__((naked));
void PAbort_Handler(void) __attribute__((naked));
void DAbort_Handler(void) __attribute__((naked));
void IRQ_Handler(void) __attribute__((naked));
void FIQ_Handler(void) __attribute__((naked));

/* Private functions */

/**
**===========================================================================
**
**  Abstract: main program
**
**===========================================================================
*/
int main(void)
{
  int i = 0;

  /* TODO - Add your application code here */
  while (1)
  {
    i++;
  }
  return 0;
}


/**
**===========================================================================
**
**  Abstract: Undefined instruction interrupt
**
**===========================================================================
*/
void Undefined_Handler(void)
{
  while (1);
}

/**
**===========================================================================
**
**  Abstract: Software interrupt (SWI) instruction
**
**===========================================================================
*/
void SWI_Handler(void)
{
  while (1);
}

/**
**===========================================================================
**
**  Abstract: Pre-fetch Abort interrupt
**
**===========================================================================
*/
void PAbort_Handler(void)
{
  while (1);
}


/**
**===========================================================================
**
**  Abstract: Data Abort interrupt
**
**===========================================================================
*/
void DAbort_Handler(void)
{
  while (1);
}

/**
**===========================================================================
**
**  Abstract: Normal interrupt
**
**===========================================================================
*/
void IRQ_Handler(void)
{
  while (1);
}

/**
**===========================================================================
**
**  Abstract: High-speed interrupt
**
**===========================================================================
*/
void FIQ_Handler(void)
{
  while (1);
}

/*
 * Minimal __assert_func used by the assert() macro
 * */
void __assert_func(const char *file, int line, const char *func, const char *failedexpr)
{
  while(1)
  {}
}

/*
 * Minimal __assert() uses __assert__func()
 * */
void __assert(const char *file, int line, const char *failedexpr)
{
   __assert_func (file, line, NULL, failedexpr);
}

